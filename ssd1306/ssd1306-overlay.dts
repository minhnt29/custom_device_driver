/dts-v1/;

/ {
    compatible = "ti,beaglebone",

    &i2c2 {
        status = "okay";
        
        ssd1306: oled@3c {
            compatible = "minhnt29,ssd1306";  // ← Key
            reg = <0x3c>;                     // ← I2C address
            status = "okay";
        };
    };
}